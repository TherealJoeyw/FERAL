## feral-os/configs/RG35XXH_defconfig
```kconfig
# FERAL OS — PAW Buildroot configuration
# Target: AArch64 (Allwinner H700 / Cortex-A53)
# Output: rootfs.tar, consumed by tools/build-paw-image.sh

# Architecture
BR2_aarch64=y

# Toolchain — internal, glibc (musl breaks Python3 compatibility)
BR2_TOOLCHAIN_BUILDROOT_GLIBC=y
BR2_TOOLCHAIN_BUILDROOT_WCHAR=y
BR2_TOOLCHAIN_BUILDROOT_LOCALE=y
BR2_TOOLCHAIN_BUILDROOT_CXX=y

# System
BR2_TARGET_GENERIC_HOSTNAME="feral-paw"
BR2_TARGET_GENERIC_ISSUE="FERAL OS"
BR2_TARGET_GENERIC_ROOT_PASSWD=""
BR2_INIT_BUSYBOX=y
BR2_ENABLE_LOCALE=y

# Root filesystem — plain tar, no compression
# tools/build-paw-image.sh extracts this directly into the ext4 partition
BR2_TARGET_ROOTFS_TAR=y
BR2_TARGET_ROOTFS_TAR_NONE=y

# SSH
BR2_PACKAGE_DROPBEAR=y

# WiFi
BR2_PACKAGE_WPA_SUPPLICANT=y
BR2_PACKAGE_WPA_SUPPLICANT_DAEMON=y
BR2_PACKAGE_WPA_SUPPLICANT_NL80211=y

# Bluetooth
BR2_PACKAGE_BLUEZ5_UTILS=y
BR2_PACKAGE_BLUEZ5_UTILS_CLIENT=y

# Networking
BR2_PACKAGE_IPROUTE2=y

# Entropy — required for dropbear host key generation on first boot
BR2_PACKAGE_HAVEGED=y

# Python 3
BR2_PACKAGE_PYTHON3=y

# Hardware / debug tools
BR2_PACKAGE_I2C_TOOLS=y
BR2_PACKAGE_GPSD=y

# General utilities
BR2_PACKAGE_UTIL_LINUX=y
BR2_PACKAGE_UTIL_LINUX_BINARIES=y
```
